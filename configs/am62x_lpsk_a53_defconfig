## configs/am62x_lpsk_a53_defconfig
```kconfig
#include <configs/am62x_evm_a53_defconfig>

CONFIG_ARM=y
CONFIG_ARCH_K3=y
CONFIG_DEFAULT_DEVICE_TREE="ti/k3-am62-lp-sk"
CONFIG_OF_UPSTREAM=y
CONFIG_SOC_K3_AM625=y
CONFIG_TARGET_AM625_A53_EVM=y
CONFIG_SPL_SIZE_LIMIT=0x80000
CONFIG_SPL_MTD=y
CONFIG_SPL_MTD_LOAD=y
CONFIG_SPL_MTD_NAND_LOAD=y
CONFIG_SYS_MTD_U_BOOT_OFFS=0x280000
CONFIG_SPL_NAND_SPI_SUPPORT=y
CONFIG_CMD_MTD=y
CONFIG_SPL_DM_DEVICE_REMOVE=y
CONFIG_DM_MTD=y
CONFIG_DFU_MTD=y
CONFIG_MTD_SPI_NAND=y
CONFIG_MTD_SPI_NAND_WINBOND=y
CONFIG_MTD_SPI_NAND_MICRON=y
CONFIG_MTD_SPI_NAND_GIGADEVICE=y
# CONFIG_MTD_SPI_NAND_ALLIANCEMEMORY is not set
# CONFIG_MTD_SPI_NAND_ATO is not set
# CONFIG_MTD_SPI_NAND_ESMT is not set
# CONFIG_MTD_SPI_NAND_FMSH is not set
# CONFIG_MTD_SPI_NAND_FORESEE is not set
# CONFIG_MTD_SPI_NAND_MACRONIX is not set
# CONFIG_MTD_SPI_NAND_PARAGON is not set
# CONFIG_MTD_SPI_NAND_SKYHIGH is not set
# CONFIG_MTD_SPI_NAND_TOSHIBA is not set
# CONFIG_MTD_SPI_NAND_XTX is not set
```

## configs/am62x_lpsk_r5_defconfig
```kconfig
#include <configs/am62x_evm_r5_defconfig>

CONFIG_ARM=y
CONFIG_ARCH_K3=y
CONFIG_DEFAULT_DEVICE_TREE="k3-am62-r5-lp-sk"
CONFIG_SOC_K3_AM625=y
CONFIG_TARGET_AM625_R5_EVM=y
CONFIG_SPL_MTD=y
CONFIG_SPL_MTD_LOAD=y
CONFIG_SPL_MTD_NAND_LOAD=y
CONFIG_SPL_NAND_SPI_SUPPORT=y
CONFIG_SPL_DM_DEVICE_REMOVE=y
CONFIG_DM_MTD=y
CONFIG_MTD_SPI_NAND=y
CONFIG_MTD_SPI_NAND_WINBOND=y
CONFIG_MTD_SPI_NAND_MICRON=y
CONFIG_MTD_SPI_NAND_GIGADEVICE=y
# CONFIG_MTD_SPI_NAND_ALLIANCEMEMORY is not set
# CONFIG_MTD_SPI_NAND_ATO is not set
# CONFIG_MTD_SPI_NAND_ESMT is not set
# CONFIG_MTD_SPI_NAND_FMSH is not set
# CONFIG_MTD_SPI_NAND_FORESEE is not set
# CONFIG_MTD_SPI_NAND_MACRONIX is not set
# CONFIG_MTD_SPI_NAND_PARAGON is not set
# CONFIG_MTD_SPI_NAND_SKYHIGH is not set
# CONFIG_MTD_SPI_NAND_TOSHIBA is not set
# CONFIG_MTD_SPI_NAND_XTX is not set
```

## drivers/dma/ti/Kconfig
```kconfig
# SPDX-License-Identifier: GPL-2.0+

if ARCH_K3

config TI_K3_NAVSS_UDMA
        bool "Texas Instruments UDMA"
        depends on ARCH_K3
        select DMA
        select TI_K3_NAVSS_RINGACC
        select TI_K3_NAVSS_PSILCFG
        select TI_K3_PSIL
        help
          Support for UDMA used in K3 devices.

config TI_K3_UDMA_V2
        bool "Texas Instruments UDMA V2"
        depends on ARCH_K3
        select DMA
        select TI_K3_NAVSS_RINGACC
        select TI_K3_NAVSS_PSILCFG
        select TI_K3_PSIL
        help
          Support for low cost UDMA variant present on AM62L. Also
          referred to as BCDMA_V2/PKTDMA_V2.

endif

config TI_K3_PSIL
	bool
```

## drivers/mtd/nand/spi/Kconfig
```kconfig
menuconfig MTD_SPI_NAND
	bool "SPI NAND device Support"
	depends on DM_MTD && DM_SPI
	select MTD_NAND_CORE
	select SPI_MEM
	help
	  This is the framework for the SPI NAND device drivers.

if MTD_SPI_NAND

config MTD_SPI_NAND_ALLIANCEMEMORY
	bool "Alliance Memory SPI NAND support"
	default y if !XPL_BUILD
	help
	  Enable support for Alliance Memory SPI NAND devices.
	  In SPL/TPL this defaults to n; enable only if the target
	  board uses an Alliance Memory device, to reduce code size.

config MTD_SPI_NAND_ATO
	bool "ATO SPI NAND support"
	default y if !XPL_BUILD
	help
	  Enable support for ATO SPI NAND devices.
	  In SPL/TPL this defaults to n; enable only if the target
	  board uses an ATO device, to reduce code size.

config MTD_SPI_NAND_ESMT
	bool "ESMT SPI NAND support"
	default y if !XPL_BUILD
	help
	  Enable support for ESMT SPI NAND devices.
	  In SPL/TPL this defaults to n; enable only if the target
	  board uses an ESMT device, to reduce code size.

config MTD_SPI_NAND_FMSH
	bool "FMSH SPI NAND support"
	default y if !XPL_BUILD
	help
	  Enable support for FMSH SPI NAND devices.
	  In SPL/TPL this defaults to n; enable only if the target
	  board uses an FMSH device, to reduce code size.

config MTD_SPI_NAND_FORESEE
	bool "Foresee SPI NAND support"
	default y if !XPL_BUILD
	help
	  Enable support for Foresee SPI NAND devices.
	  In SPL/TPL this defaults to n; enable only if the target
	  board uses a Foresee device, to reduce code size.

config MTD_SPI_NAND_GIGADEVICE
	bool "GigaDevice SPI NAND support"
	default y if !XPL_BUILD
	help
	  Enable support for GigaDevice SPI NAND devices.
	  In SPL/TPL this defaults to n; enable only if the target
	  board uses a GigaDevice device, to reduce code size.

config MTD_SPI_NAND_MACRONIX
	bool "Macronix SPI NAND support"
	default y if !XPL_BUILD
	help
	  Enable support for Macronix SPI NAND devices.
	  In SPL/TPL this defaults to n; enable only if the target
	  board uses a Macronix device, to reduce code size.

config MTD_SPI_NAND_MICRON
	bool "Micron SPI NAND support"
	default y if !XPL_BUILD
	help
	  Enable support for Micron SPI NAND devices.
	  In SPL/TPL this defaults to n; enable only if the target
	  board uses a Micron device, to reduce code size.

config MTD_SPI_NAND_PARAGON
	bool "Paragon SPI NAND support"
	default y if !XPL_BUILD
	help
	  Enable support for Paragon SPI NAND devices.
	  In SPL/TPL this defaults to n; enable only if the target
	  board uses a Paragon device, to reduce code size.

config MTD_SPI_NAND_SKYHIGH
	bool "SkyHigh SPI NAND support"
	default y if !XPL_BUILD
	help
	  Enable support for SkyHigh SPI NAND devices.
	  In SPL/TPL this defaults to n; enable only if the target
	  board uses a SkyHigh device, to reduce code size.

config MTD_SPI_NAND_TOSHIBA
	bool "Toshiba SPI NAND support"
	default y if !XPL_BUILD
	help
	  Enable support for Toshiba SPI NAND devices.
	  In SPL/TPL this defaults to n; enable only if the target
	  board uses a Toshiba device, to reduce code size.

config MTD_SPI_NAND_WINBOND
	bool "Winbond SPI NAND support"
	default y if !XPL_BUILD
	help
	  Enable support for Winbond SPI NAND devices.
	  In SPL/TPL this defaults to n; enable only if the target
	  board uses a Winbond device, to reduce code size.

config MTD_SPI_NAND_XTX
	bool "XTX SPI NAND support"
	default y if !XPL_BUILD
	help
	  Enable support for XTX SPI NAND devices.
	  In SPL/TPL this defaults to n; enable only if the target
	  board uses an XTX device, to reduce code size.

endif
```
